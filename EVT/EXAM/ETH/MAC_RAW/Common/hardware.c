/********************************** (C) COPYRIGHT  *******************************
* File Name          : hardware.c
* Author             : WCH
* Version            : V1.0.0
* Date               : 2025/03/01
* Description        : This file provides all the hardware firmware functions.
*********************************************************************************
* Copyright (c) 2025 Nanjing Qinheng Microelectronics Co., Ltd.
* Attention: This software (modified or not) and binary are used for 
* microcontroller manufactured by Nanjing Qinheng Microelectronics.
*******************************************************************************/
#include "hardware.h"

#include "eth_driver.h"

extern uint8_t volatile LinkSta; //0: No valid link established   1:Valid link establishe

uint8_t MACAddr[6];

uint8_t ARPPackage[500]=
{
    0xff, 0xff, 0xff, 0xff, 0xff, 0xff,     /* destination MAC address */
    0x84, 0xc2, 0xe4, 0x01, 0x02, 0x03,     /* source MAC address */
    0x08,0x06,                              /* Type:ARP */
    0x00,0x01,                              /* Hardware type:Ethernet(1) */
    0x08,0x00,                              /* Protocol type:IPv4 */
    0x06,0x04,                              /* Hardware size and Protocol size*/
    0x00,0x01,                              /* Opcode:request(1) */
    0x84, 0xc2, 0xe4, 0x01, 0x02, 0x03,     /* Sender MAC address */
    0xc0,0xa8,0x1,0x0f,                     /* Sender IP address */
    0x00,0x00,0x00,0x00,0x00,0x00,          /* Target MAC address */
    0xc0,0xa8,0x1,0x64,                     /* Target IP address */
#if 1 /*padding 16 bytes * line numbers   */
    0x55,0x55,0x55,0x55,0x55,0x55,0x55,0x55,0x55,0x55,0x55,0x55,0x55,0x55,0x55,0x55,
    0x55,0x55,0x55,0x55,0x55,0x55,0x55,0x55,0x55,0x55,0x55,0x55,0x55,0x55,0x55,0x55,
    0x55,0x55,0x55,0x55,0x55,0x55,0x55,0x55,0x55,0x55,0x55,0x55,0x55,0x55,0x55,0x55,
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    0x55,0x55,0x55,0x55,0x55,0x55,0x55,0x55,0x55,0x55,0x55,0x55,0x55,0x55,0x55,0x55
#endif
};

/*********************************************************************
 * @fn      TIM2_Init
 *
 * @brief   Initializes TIM2.
 *
 * @return  none
 */
void TIM2_Init(void)
{
    TIM_TimeBaseInitTypeDef TIM_TimeBaseStructure = { 0 };

	RCC_HB1PeriphClockCmd(RCC_HB1Periph_TIM2, ENABLE);

    TIM_TimeBaseStructure.TIM_Period = SystemCoreClock / 1000000;
    TIM_TimeBaseStructure.TIM_Prescaler = WCHNETTIMERPERIOD * 1000 - 1;
    TIM_TimeBaseStructure.TIM_ClockDivision = 0;
    TIM_TimeBaseStructure.TIM_CounterMode = TIM_CounterMode_Up;
    TIM_TimeBaseInit(TIM2, &TIM_TimeBaseStructure);
    TIM_ITConfig(TIM2, TIM_IT_Update, ENABLE);

    TIM_Cmd(TIM2, ENABLE);
    TIM_ClearITPendingBit(TIM2, TIM_IT_Update);
    NVIC_EnableIRQ(TIM2_IRQn);
}

/*********************************************************************
 * @fn      Hardware
 *
 * @brief   MAC RAW example, demonstrating that MAC RAW receives and sends data.
 *
 * @return  none
 */
void Hardware(void)
{
    u8 i;
	uint32_t PktCnt = 0;
    printf("MAC RAW Test\r\n");
    printf("SystemClk:%d\r\n", SystemCoreClock);
    printf("ChipID:%08x\r\n", DBGMCU_GetCHIPID());
    WCHNET_GetMacAddr(MACAddr);                                 //get the chip MAC address
    printf("mac addr:");
    for(i = 0; i < 6; i++)
        printf("%x ", MACAddr[i]);
    printf("\n");
	TIM2_Init();
	ETH_Init(MACAddr);
	while(1)
	{
		WCHNET_MainTask();
        if(LinkSta)
        {
            MACRAW_Tx(ARPPackage, sizeof(ARPPackage));
            if(++PktCnt % 100 == 0)
                printf("PktCnt:%d\r\n",PktCnt);
            Delay_Ms(100);
        }
	}
}
