/********************************** (C) COPYRIGHT *******************************
 * File Name          : RGB1W.c
 * Author             : WCH
 * Version            : V1.0.1
 * Date               : 2025/03/01
 * Description        : 1-wire example 1W-RGB, 1W-DS1820
 *********************************************************************************
 * Copyright (c) 2021 Nanjing Qinheng Microelectronics Co., Ltd.
 * Attention: This software (modified or not) and binary are used for
 * microcontroller manufactured by Nanjing Qinheng Microelectronics.
 *******************************************************************************/

__attribute__((aligned(16)))  const unsigned char PIOC_1W_CODE[] =
{	
	0x00,0x00,0x00,0x00,0x00,0x00,0x00,0x00,0x1F,0x60,0x00,0x00,0x00,0x00,0x00,0x00,
	0x00,0x00,0x00,0x00,0x00,0x00,0x00,0x00,0x00,0x00,0x30,0x00,0x00,0x00,0x08,0x70,
	0x00,0x00,0x08,0x70,0x00,0x00,0x08,0x70,0x00,0x00,0x00,0x00,0x00,0x00,0x08,0x70,
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	0x06,0x72,0x16,0x72,0x20,0x10,0x16,0x72,0x21,0x10,0xF5,0x71,0x30,0x00,0x00,0x00
};

#include "RGB1W.h"
#include "ch32h417.h"
#include <string.h>

/* PIOC IO 0/1 pin select definition */
/*Some pins are powered by VIO18, please pay attention
  to the voltage level of this pin when using it.*/
#define	PIOC_IO0_1	1 //PB8
#define PIOC_IO0_2  2 //PC1 
#define PIOC_IO0_3  3 //PE3
#define PIOC_IO0_4  4 //PF12
#define PIOC_IO1_1	5 //PB9
#define PIOC_IO1_2	6 //PC0
#define PIOC_IO1_3	7 //PC2
#define PIOC_IO1_4	8 //PE4
#define PIOC_IO1_5	9 //PF13
#define PIOC_IO1_6	10 //PF14

#define  PIOC_IO    PIOC_IO0_2

__IO  uint8_t	stat;

void PIOC_IRQHandler(void) __attribute__((interrupt("WCH-Interrupt-fast")));

/*********************************************************************
 * @fn      PIOC_IRQHandler
 *
 * @brief   This function handles PIOC exception.
 *
 * @return  none
 */
void PIOC_IRQHandler( void )
{
//	uint8_t	stat;
	stat = PIOC->D8_CTRL_RD;//auto remove interrupt request after reading
//	if ( stat == RGB1W_ERR_OK ) printf("1-wire finished\r\n");
//	else printf("1-wire error %02x\r\n", stat);
//	temper = PIOC->D16_DATA_REG0_1;//for DS1820 only
}

/*********************************************************************
 * @fn      RGB1W_Init
 *
 * @brief   Init RGB1W.
 *
 * @return  none
 */
void RGB1W_Init ( void ) 
{
    GPIO_InitTypeDef GPIO_InitStructure = {0};

/***** PIOC IO0 pin select *****/
#if(PIOC_IO == PIOC_IO0_1)
    RCC_HB2PeriphClockCmd(RCC_HB2Periph_AFIO | RCC_HB2Periph_GPIOB, ENABLE);
    RCC_HBPeriphClockCmd(RCC_HBPeriph_PIOC, ENABLE);

	GPIO_PinRemapConfig(GPIO_Remap_SWJ_Disable, ENABLE);
	GPIO_PinAFConfig(GPIOB, GPIO_PinSource8, GPIO_AF5);

	GPIO_InitStructure.GPIO_Pin = GPIO_Pin_8;
    GPIO_InitStructure.GPIO_Mode = GPIO_Mode_AF_PP;
    GPIO_InitStructure.GPIO_Speed = GPIO_Speed_Very_High;
    GPIO_Init(GPIOB, &GPIO_InitStructure);

#elif(PIOC_IO == PIOC_IO0_2)
    RCC_HB2PeriphClockCmd(RCC_HB2Periph_AFIO | RCC_HB2Periph_GPIOC, ENABLE);
    RCC_HBPeriphClockCmd(RCC_HBPeriph_PIOC, ENABLE);
	GPIO_PinAFConfig(GPIOC, GPIO_PinSource1, GPIO_AF7);

	GPIO_InitStructure.GPIO_Pin = GPIO_Pin_1;
    GPIO_InitStructure.GPIO_Mode = GPIO_Mode_AF_PP;
    GPIO_InitStructure.GPIO_Speed = GPIO_Speed_Very_High;
    GPIO_Init(GPIOC, &GPIO_InitStructure);

#elif(PIOC_IO == PIOC_IO0_3)
    RCC_HB2PeriphClockCmd(RCC_HB2Periph_AFIO | RCC_HB2Periph_GPIOE, ENABLE);
    RCC_HBPeriphClockCmd(RCC_HBPeriph_PIOC, ENABLE);
	GPIO_PinAFConfig(GPIOE, GPIO_PinSource3, GPIO_AF5);

	GPIO_InitStructure.GPIO_Pin = GPIO_Pin_3;
    GPIO_InitStructure.GPIO_Mode = GPIO_Mode_AF_PP;
    GPIO_InitStructure.GPIO_Speed = GPIO_Speed_Very_High;
    GPIO_Init(GPIOE, &GPIO_InitStructure);

#elif(PIOC_IO == PIOC_IO0_4)
    RCC_HB2PeriphClockCmd(RCC_HB2Periph_AFIO | RCC_HB2Periph_GPIOF, ENABLE);
    RCC_HBPeriphClockCmd(RCC_HBPeriph_PIOC, ENABLE);
	GPIO_PinAFConfig(GPIOF, GPIO_PinSource12, GPIO_AF3);

	GPIO_InitStructure.GPIO_Pin = GPIO_Pin_12;
    GPIO_InitStructure.GPIO_Mode = GPIO_Mode_AF_PP;
    GPIO_InitStructure.GPIO_Speed = GPIO_Speed_Very_High;
    GPIO_Init(GPIOF, &GPIO_InitStructure);

/***** PIOC IO1 pin select *****/
#elif(PIOC_IO == PIOC_IO1_1)

    RCC_HB2PeriphClockCmd(RCC_HB2Periph_AFIO | RCC_HB2Periph_GPIOB, ENABLE);
    RCC_HBPeriphClockCmd(RCC_HBPeriph_PIOC, ENABLE);

	GPIO_PinRemapConfig(GPIO_Remap_SWJ_Disable, ENABLE);
	GPIO_PinAFConfig(GPIOB, GPIO_PinSource9, GPIO_AF7);

	GPIO_InitStructure.GPIO_Pin = GPIO_Pin_9;
    GPIO_InitStructure.GPIO_Mode = GPIO_Mode_AF_PP;
    GPIO_InitStructure.GPIO_Speed = GPIO_Speed_Very_High;
    GPIO_Init(GPIOB, &GPIO_InitStructure);

#elif(PIOC_IO == PIOC_IO1_2)
    RCC_HB2PeriphClockCmd(RCC_HB2Periph_AFIO | RCC_HB2Periph_GPIOC, ENABLE);
    RCC_HBPeriphClockCmd(RCC_HBPeriph_PIOC, ENABLE);
	GPIO_PinAFConfig(GPIOC, GPIO_PinSource0, GPIO_AF5);

	GPIO_InitStructure.GPIO_Pin = GPIO_Pin_0;
    GPIO_InitStructure.GPIO_Mode = GPIO_Mode_AF_PP;
    GPIO_InitStructure.GPIO_Speed = GPIO_Speed_Very_High;
    GPIO_Init(GPIOC, &GPIO_InitStructure);

#elif(PIOC_IO == PIOC_IO1_3)
    RCC_HB2PeriphClockCmd(RCC_HB2Periph_AFIO | RCC_HB2Periph_GPIOC, ENABLE);
    RCC_HBPeriphClockCmd(RCC_HBPeriph_PIOC, ENABLE);
	GPIO_PinAFConfig(GPIOC, GPIO_PinSource2, GPIO_AF8);

	GPIO_InitStructure.GPIO_Pin = GPIO_Pin_2;
    GPIO_InitStructure.GPIO_Mode = GPIO_Mode_AF_PP;
    GPIO_InitStructure.GPIO_Speed = GPIO_Speed_Very_High;
    GPIO_Init(GPIOC, &GPIO_InitStructure);

#elif(PIOC_IO == PIOC_IO1_4)
    RCC_HB2PeriphClockCmd(RCC_HB2Periph_AFIO | RCC_HB2Periph_GPIOE, ENABLE);
    RCC_HBPeriphClockCmd(RCC_HBPeriph_PIOC, ENABLE);
	GPIO_PinAFConfig(GPIOE, GPIO_PinSource4, GPIO_AF4);

	GPIO_InitStructure.GPIO_Pin = GPIO_Pin_4;
    GPIO_InitStructure.GPIO_Mode = GPIO_Mode_AF_PP;
    GPIO_InitStructure.GPIO_Speed = GPIO_Speed_Very_High;
    GPIO_Init(GPIOE, &GPIO_InitStructure);

#elif(PIOC_IO == PIOC_IO1_5)
    RCC_HB2PeriphClockCmd(RCC_HB2Periph_AFIO | RCC_HB2Periph_GPIOF, ENABLE);
    RCC_HBPeriphClockCmd(RCC_HBPeriph_PIOC, ENABLE);
	GPIO_PinAFConfig(GPIOF, GPIO_PinSource13, GPIO_AF5);

	GPIO_InitStructure.GPIO_Pin = GPIO_Pin_13;
    GPIO_InitStructure.GPIO_Mode = GPIO_Mode_AF_PP;
    GPIO_InitStructure.GPIO_Speed = GPIO_Speed_Very_High;
    GPIO_Init(GPIOF, &GPIO_InitStructure);

#elif(PIOC_IO == PIOC_IO1_6)
    RCC_HB2PeriphClockCmd(RCC_HB2Periph_AFIO | RCC_HB2Periph_GPIOF, ENABLE);
    RCC_HBPeriphClockCmd(RCC_HBPeriph_PIOC, ENABLE);
	GPIO_PinAFConfig(GPIOF, GPIO_PinSource14, GPIO_AF5);

	GPIO_InitStructure.GPIO_Pin = GPIO_Pin_14;
    GPIO_InitStructure.GPIO_Mode = GPIO_Mode_AF_PP;
    GPIO_InitStructure.GPIO_Speed = GPIO_Speed_Very_High;
    GPIO_Init(GPIOF, &GPIO_InitStructure);

#endif

	PIOC->D8_SYS_CFG = RB_MST_RESET | RB_MST_IO_EN0| RB_MST_IO_EN1;	// reset PIOC & enable IO0 IO1

	memcpy( (uint8_t *)(PIOC_SRAM_BASE), PIOC_1W_CODE, sizeof( PIOC_1W_CODE ) ); // load code for PIOC

//    NVIC_EnableIRQ(PIOC_IRQn);//enable interrupt
//    NVIC_SetPriority(PIOC_IRQn,0xf0);
}

/*********************************************************************
 * @fn      RGB1W_SendSFR
 *
 * @brief   SFR mode for 1~32 bytes data.
 *
 * @param   total_bytes - total data number(byte).
 *          p_source_addr - data.
 *          mod - 0:PIOC IO 0
 *                1:PIOC IO 1
 *
 * @return  none
 */
void RGB1W_SendSFR( uint16_t total_bytes, uint8_t *p_source_addr ,uint8_t mod) {//SFR mode for 1~32 bytes data
// p_source_addr: point source data buffer start address, set NULL if copy into PIOC buffer already.HCLK default is 100MHz.
	if ( total_bytes > RGB1W_SFR_SIZE ) return;
	PIOC->D8_SYS_CFG = RB_MST_RESET | RB_MST_IO_EN0 | RB_MST_IO_EN1;//clear&halt PIOC
	PIOC->D8_SYS_CFG = RB_MST_CLK_GATE | RB_MST_IO_EN0 | RB_MST_IO_EN1;//run PIOC before write SFR
	if ( p_source_addr ) memcpy( RGB1W_SFR_ADDR, p_source_addr, total_bytes );//copy source data to RGB1W SFR, @PIOC run
	if(mod)
	    RGB1W_COMMAND = ((uint8_t)total_bytes|0X40);// PIOC start send
	else
	    RGB1W_COMMAND = (uint8_t)total_bytes;// PIOC start send
}

/*********************************************************************
 * @fn      RGB1W_SendRAM
 *
 * @brief   RAM mode for 1~3072 bytes data.
 *
 * @param   total_bytes - total data number(byte).
 *          p_source_addr - data.
 *          mod - 0:PIOC IO 0
 *                1:PIOC IO 1
 *
 * @return  none
 */
void RGB1W_SendRAM( uint16_t total_bytes, uint8_t *p_source_addr ,uint8_t mod) {//RAM mode for 1~3072 bytes data
// p_source_addr: point source data buffer start address, set NULL if copy into PIOC buffer already
	if ( total_bytes > RGB1W_RAM_SIZE ) return;
	PIOC->D8_SYS_CFG = RB_MST_RESET | RB_MST_IO_EN0| RB_MST_IO_EN1;//clear&halt PIOC
	if ( p_source_addr ) memcpy( RGB1W_RAM_ADDR, p_source_addr, total_bytes );//copy source data to PIOC SRAM, @PIOC halt
	PIOC->D8_SYS_CFG = RB_MST_CLK_GATE | RB_MST_IO_EN0| RB_MST_IO_EN1;//run PIOC after load data in SRAM
	PIOC->D16_DATA_REG0_1 = total_bytes;// data size
	if(mod)
	{
		PIOC->D8_DATA_REG2 = 1;
		RGB1W_COMMAND = 0x55 | RGB1W_CMD_RAM;// default is 100MHz.
	} 
	else
	{
		RGB1W_COMMAND = RGB1W_CYC_100M | RGB1W_CMD_RAM;// set mode 0 bit cycle and PIOC start send
		PIOC->D8_DATA_REG2 = 0;
	}
}

/*********************************************************************
 * @fn      RGB1W_SendSFR_Wait
 *
 * @brief   SFR mode for 1~3072 bytes data wait PIOC operate finish.
 *
 * @param   total_bytes - total data number(byte).
 *          p_source_addr - data.
 *          mod - 0:PIOC IO 0
 *                1:PIOC IO 1
 * @return  none
 */
uint8_t RGB1W_SendSFR_Wait( uint16_t total_bytes, uint8_t *p_source_addr ,uint8_t mod) {//SFR mode for 1~32 bytes data
// p_source_addr: point source data buffer start address, set NULL if copy into PIOC buffer already
	if ( total_bytes == 0 || total_bytes > RGB1W_SFR_SIZE ) return( RGB1W_ERR_PARA );
	RGB1W_SendSFR( total_bytes, p_source_addr , mod);
	while ( ( PIOC->D8_SYS_CFG & RB_INT_REQ ) == 0 );//wait, PIOC request interrupt after finish
	return( PIOC->D8_CTRL_RD );//auto remove interrupt request after reading
}

/*********************************************************************
 * @fn      RGB1W_SendRAM_Wait
 *
 * @brief   RAM mode for 1~3072 bytes data wait PIOC operate finish.
 *
 * @param   total_bytes - total data number(byte).
 *          p_source_addr - data.
 *          mod - 0:PIOC IO 0
 *                1:PIOC IO 1
 * @return  none
 */
uint8_t RGB1W_SendRAM_Wait( uint16_t total_bytes, uint8_t *p_source_addr ,uint8_t mod) {//RAM mode for 1~3072 bytes data
// p_source_addr: point source data buffer start address, set NULL if copy into PIOC buffer already
	if ( total_bytes == 0 || total_bytes > RGB1W_RAM_SIZE ) return( RGB1W_ERR_PARA );
	RGB1W_SendRAM( total_bytes, p_source_addr ,mod);
	while ( ( PIOC->D8_SYS_CFG & RB_INT_REQ ) == 0 );//wait, PIOC request interrupt after finish
	return( PIOC->D8_CTRL_RD );//auto remove interrupt request after reading
}

/*********************************************************************
 * @fn      RGB1W_Halt
 *
 * @brief   halt/sleep PIOC .
 *
 * @return  none
 */
void RGB1W_Halt( void ) {//halt/sleep PIOC
	PIOC->D8_SYS_CFG &= ~ RB_MST_CLK_GATE;
}

